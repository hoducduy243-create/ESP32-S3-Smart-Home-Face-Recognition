## slave_esp32cam/sdkconfig.defaults
```kconfig
CONFIG_IDF_TARGET="esp32"

# Bật Flash 4MB
CONFIG_ESPTOOLPY_FLASHSIZE_4MB=y
CONFIG_ESPTOOLPY_FLASHSIZE="4MB"
CONFIG_ESPTOOLPY_FLASHFREQ_80M=y

# Phân vùng tùy chỉnh (app 3MB thay vì 1MB mặc định)
CONFIG_PARTITION_TABLE_CUSTOM=y
CONFIG_PARTITION_TABLE_CUSTOM_FILENAME="partitions.csv"

# Bật PSRAM
CONFIG_SPIRAM=y
CONFIG_SPIRAM_BOOT_INIT=y
CONFIG_SPIRAM_USE_MALLOC=y
CONFIG_SPIRAM_TYPE_AUTO=y

CONFIG_ESP_MAIN_TASK_STACK_SIZE=8192
CONFIG_OV3660_SUPPORT=y
```
